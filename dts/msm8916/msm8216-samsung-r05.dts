// SPDX-License-Identifier: GPL-2.0-only

/dts-v1/;

#include <skeleton.dtsi>

/ {
	// This is used by the bootloader to find the correct DTB
	qcom,msm-id = <248 0>;
	qcom,board-id = <0xF808FF01 5>;

	j53g-eur {
		model = "Samsung Galaxy J5 2015 (SM-J500H)";
		compatible = "samsung,j53g-eur", "qcom,msm8916", "lk2nd,device";
		lk2nd,match-bootloader = "J500H*";

		samsung,muic-reset {
			i2c-gpio-pins = <105 106>;
			i2c-address = <0x25>;
		};
	};
	
	a53g {
		// Samsung Galaxy 3G SM-A500H
		model = "Samsung Galaxy A5 (SM-A500H)";
		compatible = "samsung,a53g", "qcom,msm8916", "lk2nd,device";
		lk2nd,match-bootloader = "A500H*";
		lk2nd,smd-rpm-hack-opening;

		qcom,msm-id = <206 0>;
		qcom,board-id = <0xCE08FF01 8>;
	};
};
